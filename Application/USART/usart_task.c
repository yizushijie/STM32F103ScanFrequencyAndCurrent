#include "usart_task.h"

//===全局变量的定义
UINT8_T USART1_RX_BUFFER[USART1_RX_MAX_SIZE] = { 0 };
UINT8_T USART1_TX_BUFFER[USART1_RX_MAX_SIZE] = { 0 };

///////////////////////////////////////////////////////////////////////////////
//////函		数：
//////功		能：
//////输入参数:
//////输出参数:
//////说		明：
//////////////////////////////////////////////////////////////////////////////
UINT8_T  USARTTask_Init(USART_HandlerType*  USARTx, UINT16_T rxSize, UINT8_T* pRxVal, UINT8_T rxCRCFlag, UINT16_T txSize, UINT8_T* pTxVal, UINT8_T txCRCFlag, UINT32_T(*pTimerTick)(void))
{
	UINT8_T _return = OK_0;
	_return = USARTLib_Init(USARTx, rxSize, pRxVal, rxCRCFlag, txSize, pTxVal, txCRCFlag, pTimerTick);
	_return = USARTLib_DeviceInit(USARTx, USART1_DEVICE_ID, USART1_ID_INDEX, USART1_CMD_INDEX, USART1_DATA1_INDEX, USART1_DATA2_INDEX);
	return _return;
}

///////////////////////////////////////////////////////////////////////////////
//////函		数：
//////功		能：
//////输入参数:
//////输出参数:
//////说		明：
//////////////////////////////////////////////////////////////////////////////
UINT8_T  USARTTask_DeInit(USART_HandlerType*  USARTx)
{
	return USARTLib_DeInit(USARTx);
}

///////////////////////////////////////////////////////////////////////////////
//////函		数：
//////功		能：
//////输入参数:
//////输出参数:
//////说		明：
//////////////////////////////////////////////////////////////////////////////
UINT8_T USARTTask_DeviceInit(USART_HandlerType *USARTx, UINT8_T id, UINT8_T idIndex, UINT8_T cmdIndex, UINT8_T d1Index, UINT8_T d2Index)
{
	return USARTLib_DeviceInit(USARTx, id, idIndex, cmdIndex, d1Index, d2Index);
}

///////////////////////////////////////////////////////////////////////////////
//////函		数：
//////功		能：
//////输入参数:
//////输出参数:
//////说		明：
//////////////////////////////////////////////////////////////////////////////
UINT8_T  USARTTask_ReadInit(USART_HandlerType*  USARTx)
{
	return USARTLib_ReadInit(USARTx);
}
///////////////////////////////////////////////////////////////////////////////
//////函		数：
//////功		能：
//////输入参数:
//////输出参数:
//////说		明：
//////////////////////////////////////////////////////////////////////////////
UINT8_T  USARTTask_GetReadState(USART_HandlerType* USARTx)
{
	return USARTLib_GetReadState(USARTx);
}

///////////////////////////////////////////////////////////////////////////////
//////函		数：
//////功		能：
//////输入参数:
//////输出参数:
//////说		明：
//////////////////////////////////////////////////////////////////////////////
UINT8_T  USARTTask_ClearReadState(USART_HandlerType* USARTx)
{
	return USARTLib_ClearReadState(USARTx);
}

///////////////////////////////////////////////////////////////////////////////
//////函		数：
//////功		能：
//////输入参数:
//////输出参数:
//////说		明：
//////////////////////////////////////////////////////////////////////////////
UINT8_T  USARTTask_GetWriteState(USART_HandlerType* USARTx)
{
	return USARTLib_GetWriteState(USARTx);
}

///////////////////////////////////////////////////////////////////////////////
//////函		数：
//////功		能：
//////输入参数:
//////输出参数:
//////说		明：
//////////////////////////////////////////////////////////////////////////////
UINT8_T  USARTTask_ClearWriteState(USART_HandlerType* USARTx)
{
	return USARTLib_ClearWriteState(USARTx);
}

///////////////////////////////////////////////////////////////////////////////
//////函		数：
//////功		能：
//////输入参数:
//////输出参数:
//////说		明：
//////////////////////////////////////////////////////////////////////////////
UINT8_T  USARTTask_TimeOVFTask(USART_HandlerType*USARTx)
{
	//---发送
	//USARTLib_TimeOVFTask(USARTx, 0);
	//---接收
	return  USARTLib_TimeOVFTask(USARTx, 1);
}

///////////////////////////////////////////////////////////////////////////////
//////函		数：
//////功		能：
//////输入参数:
//////输出参数:
//////说		明：
//////////////////////////////////////////////////////////////////////////////
UINT8_T  USARTTask_ITRead_8BitsTask(USART_HandlerType*USARTx, UINT8_T val)
{
	return USARTLib_ITRead_8BitsTask(USARTx, val);
}

///////////////////////////////////////////////////////////////////////////////
//////函		数：
//////功		能：
//////输入参数:
//////输出参数:
//////说		明：
//////////////////////////////////////////////////////////////////////////////
UINT8_T  USARTTask_ITRead_16BitsTask(USART_HandlerType*USARTx, UINT8_T val)
{
	return USARTLib_ITRead_16BitsTask(USARTx, val);
}

///////////////////////////////////////////////////////////////////////////////
//////函		数：
//////功		能：
//////输入参数:
//////输出参数:
//////说		明：
//////////////////////////////////////////////////////////////////////////////
UINT8_T  USARTTask_ITRead_Task(USART_HandlerType*USARTx, UINT8_T val)
{
	return USARTLib_ITRead_Task(USARTx, val);
}

///////////////////////////////////////////////////////////////////////////////
//////函		数：
//////功		能：
//////输入参数:
//////输出参数:
//////说		明：
//////////////////////////////////////////////////////////////////////////////
UINT8_T USARTTask_WriteInit(USART_HandlerType*USARTx)
{
	return USARTLib_WriteInit(USARTx);
}

///////////////////////////////////////////////////////////////////////////////
//////函		数：
//////功		能：
//////输入参数:
//////输出参数:
//////说		明：
//////////////////////////////////////////////////////////////////////////////
UINT8_T  USARTTask_ITWrite_TXETask(USART_HandlerType*USARTx)
{
	return USARTLib_ITWrite_TXETask(USARTx);
}

///////////////////////////////////////////////////////////////////////////////
//////函		数：
//////功		能：
//////输入参数:
//////输出参数:
//////说		明：
//////////////////////////////////////////////////////////////////////////////
UINT8_T  USARTTask_ITWrite_TCTask(USART_HandlerType*USARTx)
{
	return USARTLib_ITWrite_TCTask(USARTx);
}

///////////////////////////////////////////////////////////////////////////////
//////函		数：
//////功		能：
//////输入参数:
//////输出参数:
//////说		明：
//////////////////////////////////////////////////////////////////////////////
UINT8_T  USARTTask_RealTime_AddByte(USART_HandlerType*USARTx, UINT8_T val)
{
	return USARTLib_RealTime_AddByte(USARTx, val);
}
///////////////////////////////////////////////////////////////////////////////
//////函		数：
//////功		能：
//////输入参数:
//////输出参数:
//////说		明：
//////////////////////////////////////////////////////////////////////////////
UINT8_T  USARTTask_RealTime_AddByteSize(USART_HandlerType*USARTx, UINT16_T val)
{
	return USARTLib_RealTime_AddByteSize(USARTx, val);
}

///////////////////////////////////////////////////////////////////////////////
//////函		数：
//////功		能：
//////输入参数:
//////输出参数:
//////说		明：
//////////////////////////////////////////////////////////////////////////////
UINT8_T  USARTTask_RealTime_AddByteCRC(USART_HandlerType*USARTx)
{
	return USARTLib_RealTime_AddByteCRC(USARTx);
}

///////////////////////////////////////////////////////////////////////////////
//////函		数： 
//////功		能： 
//////输入参数: 
//////输出参数: 
//////说		明： 
//////////////////////////////////////////////////////////////////////////////
UINT8_T	 USARTTask_FillMode_Init( USART_HandlerType*USARTx )
{
	return USARTLib_FillMode_Init(USARTx);
}

///////////////////////////////////////////////////////////////////////////////
//////函		数：
//////功		能：
//////输入参数:
//////输出参数:
//////说		明：
//////////////////////////////////////////////////////////////////////////////
UINT8_T USARTTask_FillMode_AddByte(USART_HandlerType*USARTx, UINT8_T val)
{
	return  USARTLib_FillMode_AddByte(USARTx, val);
}

///////////////////////////////////////////////////////////////////////////////
//////函		数：
//////功		能：
//////输入参数:
//////输出参数:
//////说		明：
//////////////////////////////////////////////////////////////////////////////
UINT8_T USARTTask_FillMode_AddData(USART_HandlerType*USARTx, UINT8_T *pVal, UINT16_T length)
{
	return  USARTLib_FillMode_AddData(USARTx, pVal, length);
}
///////////////////////////////////////////////////////////////////////////////
//////函		数：
//////功		能：
//////输入参数:
//////输出参数:
//////说		明：
//////////////////////////////////////////////////////////////////////////////
UINT8_T  USARTTask_CRCTask_Read(USART_HandlerType*USARTx)
{
	return USARTLib_CRCTask_Read(USARTx);
}

///////////////////////////////////////////////////////////////////////////////
//////函		数：
//////功		能：
//////输入参数:
//////输出参数:
//////说		明：
//////////////////////////////////////////////////////////////////////////////
UINT8_T USARTTask_CRCTask_Write(USART_HandlerType*USARTx)
{
	return USARTLib_CRCTask_Write(USARTx);
}

///////////////////////////////////////////////////////////////////////////////
//////函		数：
//////功		能：
//////输入参数:
//////输出参数:
//////说		明：
//////////////////////////////////////////////////////////////////////////////
UINT8_T USARTTask_FillMode_WriteSTART(USART_HandlerType*USARTx, UINT8_T isNeedID)
{
	return USARTLib_FillMode_WriteSTART(USARTx, isNeedID);
}

///////////////////////////////////////////////////////////////////////////////
//////函		数：
//////功		能：
//////输入参数:
//////输出参数:
//////说		明：
//////////////////////////////////////////////////////////////////////////////
UINT8_T USARTTask_PollMode_WriteByte(USART_HandlerType*USARTx, UINT8_T  val)
{
	return USARTLib_PollMode_WriteByte(USARTx, val);
}

///////////////////////////////////////////////////////////////////////////////
//////函		数：
//////功		能：
//////输入参数:
//////输出参数:
//////说		明：
//////////////////////////////////////////////////////////////////////////////
UINT8_T USARTTask_PollMode_WriteData(USART_HandlerType*USARTx, char *pVal)
{
	return  USARTLib_PollMode_WriteData(USARTx, pVal);
}

///////////////////////////////////////////////////////////////////////////////
//////函		数：
//////功		能：
//////输入参数:
//////输出参数:
//////说		明：
//////////////////////////////////////////////////////////////////////////////
void USARTTask_PrintfClockFreq(USART_HandlerType*USARTx)
{
	USARTLib_PrintfClockFreq(USARTx);
}

///////////////////////////////////////////////////////////////////////////////
//////函		数：
//////功		能：
//////输入参数:
//////输出参数:
//////说		明： 校验设备的ID信息
//////////////////////////////////////////////////////////////////////////////
UINT8_T USARTTask_DeviceID(USART_HandlerType*USARTx)
{
	return USARTLib_DeviceID(USARTx);
}

///////////////////////////////////////////////////////////////////////////////
//////函		数：
//////功		能：
//////输入参数:
//////输出参数:
//////说		明：
//////////////////////////////////////////////////////////////////////////////
UINT8_T USARTTask_FuncTask(USART_HandlerType*USARTx, UINT8_T(*pFuncTask)(UINT8_T *, UINT8_T *))
{
	UINT16_T length = 0;
	if (USARTx != NULL)
	{
		//---判断接收是否完成
		if (USARTTask_GetReadState(USARTx) == 1)
		{
			//---CRC的校验
			if ((USARTTask_CRCTask_Read(USARTx) == OK_0) && (USARTTask_DeviceID(USARTx) == OK_0))
			{
				//---数据发送报头
				USARTTask_RealTime_AddByte(USARTx, USARTx->msgTxID);

				//---数据接收完成
				if (pFuncTask != NULL)
				{
					pFuncTask(USARTx->msgRxHandler.pMsgVal, USARTx->msgTxHandler.pMsgVal);
				}
				else
				{
					//USARTTask_FillMode_AddData(USARTx, USARTx->msgRxHandler.pMsgVal, length);
					//USARTTask_RealTime_AddByteSize(USARTx, USARTx->msgRxHandler.msgCount);
					USARTTask_RealTime_AddByteSize(USARTx, USARTx->msgRxHandler.msgIndexW);
					for (length = USART1_ID_INDEX; length < USARTx->msgRxHandler.msgCount; length++)
					{
						USARTTask_RealTime_AddByte(USARTx, USARTx->msgRxHandler.pMsgVal[length]);
					}

					//---是否需要增加换行符
					if (USARTx->msgTxHandler.msgAddNewLine==1)
					{
						USARTTask_RealTime_AddByte(USARTx, 0x0D);
						USARTTask_RealTime_AddByte(USARTx, 0x0A);
					}
					
				}

				//---判断是否发送CRC
				USARTTask_RealTime_AddByteCRC(USARTx);
			}
			else
			{
				//---发生CRC校验错误
				USART_Printf(USARTx, "=>>串口%d:发生CRC校验错误<<=\r\n", (USARTx->msgIndex - 1));
			}
			return USARTTask_ReadInit(USARTx);
		}
		return USARTTask_TimeOVFTask(USARTx);
	}
	return ERROR_2;
}